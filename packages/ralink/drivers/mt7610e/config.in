## packages/ralink/drivers/mt7610e/config.in
```kconfig
if PACKAGE_kmod-mt7610e

config RT_SECOND_CARD
    string
    default 7610
    depends on PACKAGE_kmod-mt7610e

config SECOND_IF_MT7610E
	bool
	default y
	depends on PACKAGE_kmod-mt7610e

config MT7610_AP
	bool # "Ralink MT7610 802.11n AP support"
	default y
	depends on PACKAGE_kmod-mt7610e
#	depends on NET_RADIO 
	select WIRELESS_EXT
	select WEXT_SPY
	select WEXT_PRIV
	
config MT7610_AP_V24_DATA_STRUCTURE
	bool
	depends on MT7610_AP
	default y
	
config  MT7610_AP_LED
	bool "LED Support"
	depends on MT7610_AP

config  MT7610_AP_WSC
	bool "WSC (WiFi Simple Config)"
	depends on MT7610_AP
	default y

config  MT7610_AP_WSC_V2
    bool "WSC 2.0(WiFi Simple Config 2.0)"
    depends on MT7610_AP_WSC
    default y

config  MT7610_AP_LLTD
	bool "LLTD (Link Layer Topology Discovery Protocol)"
	depends on MT7610_AP

config  MT7610_AP_WDS
	bool "WDS"
	depends on MT7610_AP

#config  MT7610_AP_WMM_ACM
#	bool "WMM ACM"
#	depends on MT7610_AP

config  MT7610_AP_MBSS
	bool "MBSSID"
	depends on MT7610_AP
	default y

config	NEW_MBSSID_MODE
	bool "New MBSSID MODE"
	depends on MT7610_AP
	depends on MT7610_AP_MBSS
	depends on RALINK_RT3883 || RALINK_RT3352 || RALINK_MT7620
	default y

config  MT7610_AP_APCLI
	bool "AP-CLient Support"
	depends on MT7610_AP
    default y

config  MT7610_AP_MAC_REPEATER
	bool "Mac Repeater Mode Support"
	depends on MT7610_AP
    depends on MT7610_AP_APCLI
    default y

config  MT7610_AP_IGMP_SNOOP
	bool "IGMP snooping"
	depends on MT7610_AP

#config  MT7610_AP_NETIF_BLOCK
#	bool "NETIF Block"
#	depends on MT7610_AP
#	help
#	Support Net interface block while Tx-Sw queue full

config  MT7610_AP_DFS
	bool "DFS"
	depends on MT7610_AP
#	select RALINK_TIMER
#	select RALINK_TIMER_DFS

config  MT7610_AP_CARRIER
	bool "Carrier Detect"
	depends on MT7610_AP
#	select RALINK_TIMER
#	select RALINK_TIMER_DFS

#config  MT7610_AP_DLS
#	bool "DLS ((Direct-Link Setup) Support"
#	depends on MT7610_AP

#config  MT7610_AP_IDS
#	bool "IDS (Intrusion Detection System) Support"
#	depends on MT7610_AP

#Not ready 20120726
#config  MT7610_RT3XXX_AP_ANTENNA_DIVERSITY
#	bool "Antenna Diversity Support"
#	depends on MT7610_AP

#config  MT7610_AP_WAPI
#	bool "WAPI Support"
#	depends on MT7610_AP

#config  MT7610_AP_COC
#	bool "CoC Support"
#	depends on MT7610_AP

#config  MT7610_AP_MEMORY_OPTIMIZATION
#	bool "Memory Optimization"
#	depends on MT7610_AP

#config  MT7610_AP_VIDEO_TURBINE
#	bool "Video Turbine support"
#	depends on MT7610_AP

#config  RA_CLASSIFIER
#	tristate "Ralink Flow Classifier"
#	depends on MT7610_AP_VIDEO_TURBINE
#	default n

#config  MT7610_AP_INTELLIGENT_RATE_ADAPTION
#       bool "Intelligent Rate Adaption"
#	depends on MT7610_AP
#	depends on RALINK_RT2883 || RALINK_RT3883

#config  MT7610_AP_TXBF
#        bool "Tx Bean Forming Support (Only 3883)"
#	depends on MT7610_AP
#	depends on RALINK_RT2883 || RALINK_RT3883

config M7610_CON_WPS_SUPPORT
	bool "Concurrent WPS Support"
	depends on MT7610_AP
	depends on MT7610_AP_APCLI
	depends on MT7610_AP_WSC
	depends on MT7610_AP_WSC_V2 
	default n

#config  MT7610_EXT_CHANNEL_LIST
#	bool "Extension Channel List"
#	depends on MT7610_AP

#config  MT7610_KTHREAD
#	bool "Kernel Thread"
#	depends on MT7610_AP

#config  MT7610_AUTO_CH_SELECT_ENHANCE
#	bool "Auto Channel Selection Enhancement"
#	depends on MT7610_AP

config  MT7610_AP_80211N_DRAFT3
	bool "802.11n Draft3"
	depends on MT7610_AP
	default y

config MT7610_AP_ATE
	bool "ATE support"
	depends on MT7610_AP

config MT7610_AP_QA
	bool "QA support"
	depends on MT7610_AP

#config  MT7610_AP_CSO
#	bool "CSO Support"
#	depends on MT7610_AP

config  MT7610_AP_FLASH
	bool "Flash Mode Support"
	default y
	depends on MT7610_AP

#config  MT7610_AP_HDR_TRANS
#	bool "Header Translation Rx Support"
#	depends on MT7610_AP

config  MT7610_AP_BIG_ENDIAN
	bool "Big-endian platform Support"
	depends on MT7610_AP

config  MT7610_AP_TSSI_COMPENSATION
	bool "TSSI DC Calibration & TSSI compensation Support"
	depends on MT7610_AP

config RTMP_TEMPERATURE_COMPENSATION
	bool "Tx Power Temperature Compensation"
	depends on MT7610_AP

config  MT7610_AP_SINGLE_SKU
	bool "SingleSKU Support"
	depends on MT7610_AP

#config  MT7610_80211R_FT
#	bool "802.11r Fast BSS Transition"
#	depends on MT7610_AP

#config  MT7610_80211R_RR
#	bool "802.11k Radio Resource Management"
#	depends on MT7610_AP

#config  MT7610_MCAST_RATE_SPECIFIC
#	bool "User specific tx rate of mcast pkt"
#	depends on MT7610_AP

#config  MT7610_SNMP
#	bool "Net-SNMP Support"
#	depends on MT7610_AP

endif
```

## packages/ralink/drivers/mt76x2e/config.in
```kconfig
if PACKAGE_kmod-mt76x2e

config MT76X2E_RT_FIRST_CARD
	int
	default 7602
	depends on ! PACKAGE_kmod-mt7620
	depends on ! PACKAGE_kmod-mt7628
	depends on ! PACKAGE_kmod-mt7603e

config MT76X2E_RT_SECOND_CARD
	int
	default 7612
	depends on PACKAGE_kmod-mt76x2e

config MT76X2E_WIFI_MODE_AP
	bool
	default y

config MT76X2E_RT_FIRST_IF_RF_OFFSET
	int
	default 262144

config MT76X2E_RT_SECOND_IF_RF_OFFSET
	int
	default 294912

config MT76X2E_RALINK_MT7612E
	bool
	default y

menu "AP Features"
	depends on MT76X2E_WIFI_MODE_AP

config MT76X2E_RLT_AP_SUPPORT
	tristate "Ralink RT2860 802.11n AP support"
	#	depends on NET_RADIO
	select WIRELESS_EXT
	select WEXT_SPY
	select WEXT_PRIV
	default y

config MT76X2E_WDS_SUPPORT
	bool "WDS"
	depends on MT76X2E_RLT_AP_SUPPORT

config MT76X2E_SNIFFER_SUPPORT
	bool "Sniffer Support"
	depends on MT76X2E_RLT_AP_SUPPORT
    default n

config MT76X2E_CFG80211_SUPPORT
	bool "CFG80211 Support"
	depends on MT76X2E_RLT_AP_SUPPORT
    default n

config MT76X2E_MBSS_SUPPORT
	bool "MBSSID"
	depends on MT76X2E_RLT_AP_SUPPORT
	default y

config MT76X2E_NEW_MBSSID_MODE
	bool "New MBSSID MODE"
	depends on MT76X2E_RLT_AP_SUPPORT && MT76X2E_WMBSS_SUPPORT
	depends on RALINK_RT3883 || RALINK_RT3352 || RALINK_RT5350 || RALINK_RT6352 || RALINK_MT7620
	default y

config MT76X2E_ENHANCE_NEW_MBSSID_MODE
	bool "Enhanced MBSSID mode"
	depends on MT76X2E_WNEW_MBSSID_MODE
	default y

config MT76X2E_APCLI_SUPPORT
	bool "AP-Client Support"
	depends on MT76X2E_RLT_AP_SUPPORT
    default y

config MT76X2E_MAC_REPEATER_SUPPORT
	bool "MAC Repeater Support"
	depends on MT76X2E_RLT_AP_SUPPORT
	depends on MT76X2E_WAPCLI_SUPPORT
	depends on RALINK_RT6352 || RALINK_MT7620
	default y

#config MT76X2E_MESH_SUPPORT
#	bool "MESH Support"
#	depends on MT76X2E_RLT_AP_SUPPORT

config MT76X2E_DFS_SUPPORT
	bool "DFS"
	depends on MT76X2E_RLT_AP_SUPPORT
	select RALINK_TIMER_DFS

#config MT76X2E_DOT11R_FT_SUPPORT
#	bool "802.11r Fast BSS Transition"
#	depends on MT76X2E_RLT_AP_SUPPORT

#config MT76X2E_DOT11K_RRM_SUPPORT
#	bool "802.11k Radio Resource Management"
#	depends on MT76X2E_RLT_AP_SUPPORT

config MT76X2E_LLTD_SUPPORT
	bool "LLTD (Link Layer Topology Discovery Protocol)"
	depends on MT76X2E_RLT_AP_SUPPORT

config MT76X2E_NINTENDO_AP
	bool "Nintendo AP"
	depends on MT76X2E_RLT_AP_SUPPORT

config MT76X2E_COC_SUPPORT
	bool "CoC Support"
	depends on MT76X2E_RLT_AP_SUPPORT
	default n

config MT76X2E_DELAYED_TCP_ACK_SUPPORT
	bool "Delayed TCP ACK Support"
	depends on MT76X2E_RLT_AP_SUPPORT
	default n

#config MT76X2E_ RT2860V2_SNMP
#	bool "Net-SNMP Support"
#	depends on MT76X2E_RLT_AP_SUPPORT

#config MT76X2E_MCAST_RATE_SPECIFIC
#	bool "User specific tx rate of mcast pkt"
#	depends on MT76X2E_RLT_AP_SUPPORT

#config MT76X2E_EXT_BUILD_CHANNEL_LIST
#	bool "Extension Channel List"
#	depends on MT76X2E_RLT_AP_SUPPORT

#config MT76X2E_AUTO_CH_SELECT_ENHANCE
#	bool "Auto Channel Selection Enhancement"
#	depends on MT76X2E_RLT_AP_SUPPORT

config MT76X2E_DISABLE_EDCCA
	bool "Disable EDCCA"
	depends on MT76X2E_RLT_AP_SUPPORT
	default n

config MT76X2E_MULTI_CORE_SUPPORT
	bool "multi core support"
	depends on TARGET_ramips_mt7621
	default y
endmenu

menu "WiFi Features"

config MT76X2E_FIRST_IF_EEPROM_FLASH
	bool
	default y

config MT76X2E_SECOND_IF_EEPROM_FLASH
	bool
	default y

config MT76X2E_RT_FIRST_CARD_EEPROM
	string
	default "flash"

config MT76X2E_RT_SECOND_CARD_EEPROM
	string
	default "flash"

config MT76X2E_MULTI_INF_SUPPORT
	bool 
	#default y if !MT76X2E_WFIRST_IF_NONE && !MT76X2E_WSECOND_IF_NONE

config MT76X2E_WIFI_BASIC_FUNC
	bool "Basic Functions"
	select WIRELESS_EXT
	select WEXT_SPY
	select WEXT_PRIV
	default y

config MT76X2E_WSC_INCLUDED
	bool "WSC (WiFi Simple Config)"
	default y

config MT76X2E_WSC_V2_SUPPORT
	bool "WSC V2(WiFi Simple Config Version 2.0)"
	default y
    depends on MT76X2E_WWSC_INCLUDED

config MT76X2E_WSC_NFC_SUPPORT
	bool "WSC by NFC"
	default n
    depends on MT76X2E_WWSC_INCLUDED

config MT76X2E_DOT11N_DRAFT3
	bool "802.11n Draft3"
	default y

config MT76X2E_DOT11_VHT_AC
	bool "802.11 ac"
	default y

config MT76X2E_DOT11W_PMF_SUPPORT
	bool "PMF"
	default n

config MT76X2E_TXBF_SUPPORT
	bool "Tx Bean Forming Support"
	default n

#config MT76X2E_WMM_ACM_SUPPORT
#	bool "WMM ACM"
#	default n

config MT76X2E_LLTD_SUPPORT
	bool "LLTD (Link Layer Topology Discovery Protocol)"
	default y

config MT76X2E_QOS_DLS_SUPPORT
	bool "802.11e DLS ((Direct-Link Setup) Support"
	default n

#config MT76X2E_WAPI_SUPPORT
#	bool "WAPI Support"
#	default n

config MT76X2E_CARRIER_DETECTION_SUPPORT
	bool "Carrier Detect"
	default n

config MT76X2E_IGMP_SNOOP_SUPPORT
	bool "IGMP snooping"
	default n

config MT76X2E_BLOCK_NET_IF
	bool "NETIF Block"
	default n
	help
		Support Net interface block while Tx-Sw queue full

config MT76X2E_TXBF_SUPPORT
	bool "Tx Bean Forming Support (Only 3883)"
	depends on RALINK_RT2883 || RALINK_RT3883
	default n

#config MT76X2E_VIDEO_TURBINE_SUPPORT
#	bool "Video Turbine support"
#	default n

#config MT76X2E_RA_CLASSIFIER
#	tristate "Ralink Flow Classifier"
#	default n

config MT76X2E_RATE_ADAPTION
	bool "New Rate Adaptation support"
	default y

config MT76X2E_NEW_RATE_ADAPT_SUPPORT
	bool "Intelligent Rate Adaption"
	default y

config MT76X2E_AGS_SUPPORT
	bool "Adaptive Group Switching"
	default n

config MT76X2E_IDS_SUPPORT
	bool "IDS (Intrusion Detection System) Support"
	default n

config MT76X2E_WIFI_WORK_QUEUE
	bool "Work Queue"
	default n

config MT76X2E_WIFI_SKB_RECYCLE
	bool "SKB Recycle(Linux)"
	default y

config MT76X2E_RTMP_FLASH_SUPPORT
	bool "Flash Support"
	default y

config MT76X2E_LED_CONTROL_SUPPORT
	bool "LED Support"
	default n

#config MT76X2E_SINGLE_SKU
#	bool "Single SKU"
#	default n

#config MT76X2E_SINGLE_SKU_V2
#	bool "Single SKU V2"
#	depends on MT76X2E_WSINGLE_SKU && RALINK_RT6352
#	default n

config MT76X2E_HW_ANTENNA_DIVERSITY
	bool "Antenna Diversity Support"
	depends on MT76X2E_RLT_AP_SUPPORT || MT76X2E_WRLT_STA_SUPPORT
	depends on RALINK_RT5350
	default n

config MT76X2E_ATE_SUPPORT
	bool "ATE/QA Support"
	default y

config MT76X2E_RT2860V2_AP_V24_DATA_STRUCTURE
	bool
	default y

config MT76X2E_RT2860V2_AP_32B_DESC
	bool "32 Byte Descriptor Support"
	depends on RALINK_RT6352 || RALINK_MT7620
	default n

config MT76X2E_MEMORY_OPTIMIZATION
	bool "Memory Optimization"
	default n

config MT76X2E_RTMP_INTERNAL_TX_ALC
	bool "TSSI Compensation"
	depends on RALINK_RT3350 || RALINK_RT3352 || RALINK_RT5350 || RALINK_RT6352
	default n

config MT76X2E_RTMP_TEMPERATURE_CALIBRATION
	bool "Temperature Calibration"
	depends on RALINK_RT6352
	default n

config MT76X2E_HOTSPOT
	bool "Passpoint-R1"
	default n

config MT76X2E_SINGLE_SKU_V2
	bool "Single SKU V2"
	default n

#
# Section for chip architectures
#
# "RLT MAC Support"
config MT76X2E_RLT_MAC
	bool
	default y

config MT76X2E_RLT_BBP
	bool

config MT76X2E_RLT_RF
	bool

# "RTMP MAC Support"
#config MT76X2E_RTMP_MAC
#	bool
#	default y
#
#config MT76X2E_RTMP_BBP
#	bool
#
#config MT76X2E_RTMP_RF
#	bool

#
# Section for interfaces
#
config MT76X2E_RTMP_PCI_SUPPORT
	bool

config MT76X2E_RTMP_USB_SUPPORT
	bool

config MT76X2E_RTMP_RBUS_SUPPORT
	bool

endmenu

endif
```
